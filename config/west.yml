## config/west.yml
```yaml
manifest:
  remotes:
    - name: zmkfirmware
      url-base: https://github.com/zmkfirmware
    - name: badjeff
      url-base: https://github.com/badjeff/
    - name: efogdev
      url-base: https://github.com/efogdev
    - name: nuovotaka
      url-base: https://github.com/nuovotaka
    - name: cormoran
      url-base: https://github.com/cormoran

  projects:
    - name: zmk
      remote: cormoran
      revision: 1fc72aaff7a42bd533c1f4c9b3f23c5317c745f4
      import: app/west.yml
    - name: zmk-pmw3610-driver
      remote: efogdev
      revision: 38105b4f09d6d5b94ef5a3073428719e3c356af1
    - name: zmk-report-rate-limit
      remote: efogdev
      revision: 60b18f6e55e891956c53a393728b2e9f0834a9de
    - name: zmk-pointing-acceleration-alpha
      remote: nuovotaka
      revision: 780dfcd6b796063367893ff41e233773e12fb07c
    - name: zmk-module-runtime-input-processor
      remote: cormoran
      revision: main
    - name: zmk-feature-custom-settings
      remote: cormoran
      revision: main

  self:
    path: config
```
